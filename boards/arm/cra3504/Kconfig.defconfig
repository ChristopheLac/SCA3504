## boards/arm/cra3504/Kconfig.defconfig
```kconfig
# Copyright (c) 2023 Nordic Semiconductor ASA
# SPDX-License-Identifier: Apache-2.0

if BOARD_CRA3504

config BOARD
	default "cra3504"

config BT_CTLR
   default BT

endif
```
